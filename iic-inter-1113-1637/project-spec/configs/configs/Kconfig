## iic-inter-1113-1637/project-spec/configs/configs/Kconfig
```kconfig
mainmenu "PetaLinux System Configuration"
config SUBSYSTEM_TYPE_LINUX
        bool
        default y
        select SYSTEM_ZYNQMP

config SYSTEM_ZYNQMP
        bool "ZYNQMP Configuration"
        help
          ZYNQMP Configuration for petalinux project.
          All these config options will be in /home/ruilin/ELEC3607_AUP_ZU3/bsp-aup-zu3/aup-zu3/sw/iic-inter-1113-1637/project-spec/configs/config

config SUBSYSTEM_VARIANT_ZYNQMPEG
        bool
        default y
        help

config SUBSYSTEM_DISTRO_PETALINUX
        bool
        default y
        help

source /home/ruilin/ELEC3607_AUP_ZU3/bsp-aup-zu3/aup-zu3/sw/iic-inter-1113-1637/project-spec/configs/configs/Kconfig.main
```

## iic-inter-1113-1637/project-spec/configs/rootfsconfigs/Kconfig.user
```kconfig
menu "user packages " 
config libfftw  
	 bool "libfftw"
	 help
	
config libgpiod-tools  
	 bool "libgpiod-tools"
	 help
	
config gpio-demo  
	 bool "gpio-demo"
	 help
	
config peekpoke  
	 bool "peekpoke"
	 help
	
config pipewire  
	 bool "pipewire"
	 help
	
config pipewire-tools  
	 bool "pipewire-tools"
	 help
	
config sox  
	 bool "sox"
	 help
	
config wireplumber  
	 bool "wireplumber"
	 help
	
endmenu
```
