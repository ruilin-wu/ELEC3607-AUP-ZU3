/*
 * CAUTION: This file is automatically generated by Xilinx.
 * Version: XSCT 
 * Today is: Thu Nov 13 13:33:39 2025
 */


/dts-v1/;
#include "zynqmp.dtsi"
#include "zynqmp-clk-ccf.dtsi"
#include "pl.dtsi"
#include "pcw.dtsi"
/ {
	chosen {
		bootargs = "earlycon";
		stdout-path = "serial0:115200n8";
	};
	aliases {
		i2c0 = &i2c0;
		i2c1 = &i2c1;
		i2c2 = &audio_axi_iic_aic;
		i2c3 = &axi_iic_RPI;
		serial0 = &uart1;
		serial1 = &dcc;
	};
	memory@0 {
		device_type = "memory";
		reg = <0x0 0x0 0x0 0x7ff00000>, <0x00000008 0x00000000 0x00000001 0x80000000>;
	};
};
#include "system-user.dtsi"
