/*
 * CAUTION: This file is automatically generated by PetaLinux SDK.
 * DO NOT modify this file
 */


/ {
	chosen {
		bootargs = "earlycon console=ttyPS0,115200 root=/dev/mmcblk0p2 ro rootwait";
		stdout-path = "serial0:115200n8";
	};

	options {
		u-boot {
			compatible = "u-boot,config";
			bootscr-address = /bits/ 64 <0x20000000>;
		};
	};
};

